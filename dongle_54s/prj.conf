## CMakeLists.txt
```
#
# Copyright (c) 2018 Nordic Semiconductor
#
# SPDX-License-Identifier: LicenseRef-Nordic-5-Clause
#
cmake_minimum_required(VERSION 3.20.0)

find_package(Zephyr REQUIRED HINTS $ENV{ZEPHYR_BASE})
project(NONE)

set(OPUS_LIBRARY_ROOT ${CMAKE_CURRENT_LIST_DIR}/../lib CACHE PATH "Opus library root directory")
set(ENV{OPUS_LIBRARY_ROOT} $OPUS_LIBRARY_ROOT)

zephyr_link_libraries(-mfloat-abi=hard)
zephyr_link_libraries(-mfpu=fpv4-sp-d16 -ffunction-sections -fdata-sections -fno-strict-aliasing -mthumb -mabi=aapcs)

FILE(GLOB app_sources src/*.c)
# NORDIC SDK APP START
target_sources(app PRIVATE 
    ${app_sources}
    # ../lib/adpcm_lib/dvi_adpcm.c
    ../lib/inv_esb_lib/radio.c)
# NORDIC SDK APP END

zephyr_library_include_directories(../lib/inv_esb_lib)
# zephyr_library_include_directories(../lib/adpcm_lib)
zephyr_include_directories(../lib/opus/opus_include/opus-1.2.1)
zephyr_include_directories(../lib/opus/opus_configuration)
target_link_libraries(app PRIVATE ${OPUS_LIBRARY_ROOT}/opus/opus_library/opus_lib.a)
```

## Kconfig
```
#
# Copyright (c) 2020 Nordic Semiconductor
#
# SPDX-License-Identifier: LicenseRef-Nordic-5-Clause
#

source "Kconfig.zephyr"

rsource "../lib/inv_esb_lib/Kconfig"

menu "Inverse Enhanced ShockBurst: Receiver"

config ESB_PRX_APP_LOG_LEVEL
	int "Log level for the ESB PRX sample"
	default 4

endmenu
```

## prj.conf
```kconfig
#
# Copyright (c) 2019 Nordic Semiconductor ASA
#
# SPDX-License-Identifier: LicenseRef-Nordic-5-Clause
#
# CONFIG_NCS_SAMPLES_DEFAULTS=y
CONFIG_MAIN_STACK_SIZE=4096
CONFIG_SYSTEM_WORKQUEUE_STACK_SIZE=2048
# CONFIG_ESB=y
# # CONFIG_ESB_MAX_PAYLOAD_LENGTH=110
# CONFIG_ESB_MAX_PAYLOAD_LENGTH=77



#LOG subsystem related configs
CONFIG_LOG=y
CONFIG_LOG_MODE_DEFERRED=y
CONFIG_LOG_BUFFER_SIZE=8192
# CONFIG_USB_DRIVER_LOG_LEVEL_ERR=y
# CONFIG_USB_DEVICE_LOG_LEVEL_ERR=y
# CONFIG_USB_AUDIO_LOG_LEVEL_DBG=y


#net buf options
CONFIG_NET_BUF=y

# #USB audio related configs
# CONFIG_USB_DEVICE_AUDIO=y
# # CONFIG_USB_NRFX_EVT_QUEUE_SIZE=64
# CONFIG_USB_NRFX_WORK_QUEUE_STACK_SIZE=2048
# # CONFIG_USB_MCUX_THREAD_STACK_SIZE=2048
# # CONFIG_USB_DC_NUMAKER_MSG_HANDLER_THREAD_STACK_SIZE=2048
# CONFIG_RING_BUFFER=y
# CONFIG_USB_DEVICE_STACK=y
# CONFIG_USB_DEVICE_PRODUCT="Smart Remote dongle"


# Image manager
# CONFIG_STDOUT_CONSOLE=y
# CONFIG_FLASH=y
# CONFIG_MPU_ALLOW_FLASH_WRITE=y
# CONFIG_SOC_FLASH_NRF_EMULATE_ONE_BYTE_WRITE_ACCESS=y
# CONFIG_FCB=y
# CONFIG_FLASH_MAP=y
# CONFIG_SETTINGS=y
# CONFIG_SETTINGS_FCB=y


CONFIG_NCS_SAMPLES_DEFAULTS=y

## inverse esb config
CONFIG_MULTIACK_RADIO=y
CONFIG_MULTIACK_CENTRAL=y
CONFIG_MULTIACK_PERIPH=n
CONFIG_MULTIACK_DEBUG_GPIO=y

CONFIG_GPIO=y
CONFIG_NRF_GRTC_TIMER=y
CONFIG_NRFX_GPPI=y

CONFIG_FPU=y

CONFIG_PCM_MIX=y
```

## boards/nrf54l15dk_nrf54l15_cpuapp.conf
```kconfig
#
# Copyright (c) 2025 Nordic Semiconductor
#
# SPDX-License-Identifier: LicenseRef-Nordic-5-Clause
#
CONFIG_NRFX_TIMER10=y
# Enable DPPI driver
CONFIG_NRFX_DPPI10=y

# CONFIG_PM_PARTITION_SIZE_SETTINGS_STORAGE=0x100000
```

## src/main.c
```c
/*
 * Copyright (c) 2018 Nordic Semiconductor ASA
 *
 * SPDX-License-Identifier: LicenseRef-Nordic-5-Clause
 */
#include <zephyr/device.h>
#include <zephyr/devicetree.h>
#include <zephyr/drivers/clock_control.h>
#include <zephyr/drivers/clock_control/nrf_clock_control.h>
#include <zephyr/drivers/gpio.h>
#include <zephyr/irq.h>
#include <zephyr/logging/log.h>
#include <nrf.h>
// #include <esb.h>
#include <zephyr/kernel.h>
#include <zephyr/types.h>
#include "esb_handle.h"
// #include "dvi_adpcm.h"
#include "audio_handle.h"



LOG_MODULE_REGISTER(smart_dongle, CONFIG_ESB_PRX_APP_LOG_LEVEL);

#define FW_VERSION				"1.2.0"


static const struct gpio_dt_spec leds[] = {
	GPIO_DT_SPEC_GET(DT_ALIAS(led0), gpios),
	GPIO_DT_SPEC_GET(DT_ALIAS(led1), gpios),
	GPIO_DT_SPEC_GET(DT_ALIAS(led2), gpios),
	GPIO_DT_SPEC_GET(DT_ALIAS(led3), gpios),
};



static int leds_init(void)
{
	if (!device_is_ready(leds[0].port)) {
		LOG_ERR("LEDs port not ready");
		return -ENODEV;
	}

	for (size_t i = 0; i < ARRAY_SIZE(leds); i++) {
		int err = gpio_pin_configure_dt(&leds[i], GPIO_OUTPUT);

		if (err) {
			LOG_ERR("Unable to configure LED%u, err %d.", i, err);
			return err;
		}

		gpio_pin_set(leds[i].port, leds[i].pin, 0);
	}

	return 0;
}



int leds_toggle(uint8_t idx) 
{
	// for (size_t i = 0; i < ARRAY_SIZE(leds); i++) 
	{
		gpio_pin_toggle(leds[idx].port, leds[idx].pin);
	}

	return 0;
}

int led_on_off(uint8_t idx, bool on)
{
	if (idx >= ARRAY_SIZE(leds)) {
		LOG_ERR("Invalid LED index %u", idx);
		return -EINVAL;
	}

	int err = gpio_pin_set(leds[idx].port, leds[idx].pin, on ? 1 : 0);
	if (err) {
		LOG_ERR("Failed to set LED%u state, err %d", idx, err);
		return err;
	}

	return 0;
}




int main(void)
{
	int err;

	err = leds_init();
	if (err) {
		return err;
	}

	inverse_esb_init();
	
	radio_start_poll();

	LOG_DBG("Inverse esb dongle demo, fw_version is %s", FW_VERSION);

	/* return to idle thread */
	return 0;
}
```

## src/audio_handle.h
```c
#ifndef __USB_AUDIO_APP_H__
#define __USB_AUDIO_APP_H__

#include <stdint.h>
#include "opus_application_config.h"


#define MAX_SAMPLE_RATE             16000
#define SAMPLE_BIT_WIDTH            16
#define BYTES_PER_SAMPLE            sizeof(int16_t)


#define USB_FRAME_SIZE_STEREO               (((MAX_SAMPLE_RATE * BYTES_PER_SAMPLE) / 1000) *2)

#define CONFIG_FIFO_FRAME_SPLIT_NUM         100




/* Size of a block for 1 ms of audio data. */
#define BLOCK_SIZE(_sample_rate, _number_of_ms) \
	(BYTES_PER_SAMPLE * (_sample_rate / 1000) * _number_of_ms)


#define PCM_BLOCK_SIZE				BLOCK_SIZE(MAX_SAMPLE_RATE, 1) 			// 1 ms
#define FRAME_SIZE                  (MAX_SAMPLE_RATE / 1000)
#define PCM_FRAME_BYTES 			(CONFIG_AUDIO_FRAME_SIZE_SAMPLES * CONFIG_OPUS_CHANNELS)

#define PCM_BLOCK_COUNT             100



#endif
```

## src/esb_handle.c
```c
#include <zephyr/kernel.h>
#include <zephyr/logging/log.h>
// #include <esb.h>
// #include "dvi_adpcm.h"
#include "esb_handle.h"


LOG_MODULE_DECLARE(smart_dongle, CONFIG_ESB_PRX_APP_LOG_LEVEL);


#define DEV_NUM					0xFFFF //0xFFFF being central


/*************inverse esb variables ******************************************************/

static bool new_pkt_received;


/*****************************************************************************************/
K_MSGQ_DEFINE(m_msgq_rx_payloads, sizeof(struct inv_esb_payload), 60, 4);

extern int leds_toggle(uint8_t idx);


static int received_esb_package_enqueue(uint8_t devID, const uint8_t *buf, uint32_t length)
{
	int ret = 0;
	static struct inv_esb_payload rx_payload;

	if (length > MAX_PAYLOAD_SIZE) {
		LOG_ERR("Payload length %d exceeds maximum %d", length, MAX_PAYLOAD_SIZE);
		return -EMSGSIZE;
	}

	rx_payload.dev_id = devID;
	memcpy(rx_payload.data, buf, length);
	rx_payload.length = length;
	ret = k_msgq_put(&m_msgq_rx_payloads, &rx_payload, K_NO_WAIT);
	if (ret)  {
		LOG_INF("Audio message queue is full");
		return -ENOMEM;
	}
	return ret;
}



static void radio_evt_cb(radio_evt_t const * p_event)
{
	static uint32_t timeCount1 = 0;
	static uint32_t timeCount2 = 0;

	switch(p_event->evt_id) {
	case RADIO_EVENT_CENTRAL_DATA_RCV:
		if (p_event->data_len) {
			// Toggle one of the LEDs.
			if (p_event->periph_num == 1) {
				if(0 == (timeCount1++ % 50))
					leds_toggle(0);
			} else if (p_event->periph_num == 2) {
				if(0 == (timeCount2++ % 50))
					leds_toggle(1);
			} 
			// LOG_INF("Rec %d from %d: %d", p_event->data_len, p_event->periph_num, p_event->data[0]);

			/** enqueue compressed audio data to message queue */
			received_esb_package_enqueue(p_event->periph_num, (const uint8_t *)p_event->data, p_event->data_len);		//for test
		}
		new_pkt_received = true;
		break;
	case RADIO_EVENT_CENTRAL_POLL_END:
		if (new_pkt_received) {
			new_pkt_received = false;

			increase_poll_index();
		}
		break;
	default:
		break;
	}
}


void inverse_esb_init(void)
{
	radio_init_t radio_init;

	radio_init.dev_num			= DEV_NUM;
	radio_init.mode				= PHY_MODE;
	radio_init.event_callback	= radio_evt_cb;

	radio_setup(&radio_init);
}
```

## src/esb_handle.h
```c
#ifndef __ESB_HANDLE_H__
#define __ESB_HANDLE_H__

#include <stdint.h>

#include "../../lib/inv_esb_lib/radio.h"
#include "../../lib/inv_esb_lib/radio_config_2ms.h"
#include "opus.h"
#include "opus_application_config.h"



void inverse_esb_init(void);





#endif
```
