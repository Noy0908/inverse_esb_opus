## CMakeLists.txt
```
#
# Copyright (c) 2019 Nordic Semiconductor
#
# SPDX-License-Identifier: LicenseRef-Nordic-5-Clause
#
cmake_minimum_required(VERSION 3.20.0)

find_package(Zephyr REQUIRED HINTS $ENV{ZEPHYR_BASE})
project(NONE)

set(OPUS_LIBRARY_ROOT ${CMAKE_CURRENT_LIST_DIR}/../lib CACHE PATH "Opus library root directory")
set(ENV{OPUS_LIBRARY_ROOT} $OPUS_LIBRARY_ROOT)

zephyr_link_libraries(-mfloat-abi=hard)
zephyr_link_libraries(-mfpu=fpv4-sp-d16 -ffunction-sections -fdata-sections -fno-strict-aliasing -mthumb -mabi=aapcs)

if (CONFIG_SOC_NRF5340_CPUAPP)
  message(FATAL_ERROR "This sample is not supported on the nRF53 application core")
endif()

# NORDIC SDK APP START
target_sources(app PRIVATE
  src/main.c
  src/sound_service.c
  src/esb_handler.c
  src/drivers/drv_mic.c
  src/events/mic_work_event.c
  # ../lib/adpcm_lib/dvi_adpcm.c
  ../lib/inv_esb_lib/radio.c
)

# NORDIC SDK APP END
zephyr_library_include_directories(src/drivers/)
zephyr_library_include_directories(src/events/)
# zephyr_library_include_directories(../lib/adpcm_lib)
zephyr_library_include_directories(../lib/inv_esb_lib)
zephyr_include_directories(../lib/opus/opus_include/opus-1.2.1)
zephyr_include_directories(../lib/opus/opus_configuration)
target_link_libraries(app PRIVATE ${OPUS_LIBRARY_ROOT}/opus/opus_library/opus_lib.a)
```

## Kconfig
```
#
# Copyright (c) 2020 Nordic Semiconductor
#
# SPDX-License-Identifier: LicenseRef-Nordic-5-Clause
#

source "Kconfig.zephyr"

rsource "../lib/inv_esb_lib/Kconfig"

menu "inverse esb transmiter"

config ESB_BT_LOG_LEVEL
	int "Log level for this sample"
	default 3

endmenu
```

## prj.conf
```kconfig
#
# Copyright (c) 2019 Nordic Semiconductor
#
# SPDX-License-Identifier: LicenseRef-Nordic-5-Clause
#

CONFIG_NCS_SAMPLES_DEFAULTS=y
CONFIG_HEAP_MEM_POOL_SIZE=4096
CONFIG_MAIN_STACK_SIZE=4096

# CONFIG_CONSOLE_SUBSYS=y
# CONFIG_CONSOLE_HANDLER=y
# CONFIG_CONSOLE_GETCHAR=y

# CONFIG_MPSL=y
# CONFIG_MPSL_TIMESLOT_SESSION_COUNT=2
# CONFIG_RING_BUFFER=y

#logging
CONFIG_LOG=y
# CONFIG_SERIAL=y
# CONFIG_CONSOLE=y
CONFIG_LOG_MODE_DEFERRED=y
# CONFIG_USE_SEGGER_RTT=n
# CONFIG_RTT_CONSOLE=n
# CONFIG_UART_CONSOLE=y
# CONFIG_LOG_BACKEND_RTT=n
# CONFIG_LOG_BACKEND_UART=y

# CONFIG_BT=y
# CONFIG_ESB_BT_LOG_LEVEL=3
# # CONFIG_BT_DEBUG_LOG=y
# CONFIG_BT_MAX_CONN=1
# CONFIG_BT_MAX_PAIRED=1
# CONFIG_BT_SMP=y
# CONFIG_BT_L2CAP_TX_BUF_COUNT=5
# CONFIG_BT_PERIPHERAL=y
# CONFIG_BT_DEVICE_NAME="MPSL_ESB_BLE_Demo"
# CONFIG_BT_DEVICE_APPEARANCE=962


# CONFIG_BT_BAS=y
# CONFIG_BT_HIDS=y
# CONFIG_BT_HIDS_MAX_CLIENT_COUNT=1
# CONFIG_BT_HIDS_DEFAULT_PERM_RW_ENCRYPT=y
# CONFIG_BT_GATT_UUID16_POOL_SIZE=40
# CONFIG_BT_GATT_CHRC_POOL_SIZE=20

# CONFIG_BT_CONN_CTX=y

# CONFIG_BT_DIS=y
# CONFIG_BT_DIS_PNP=y
# CONFIG_BT_DIS_MANUF="NordicSemiconductor"
# CONFIG_BT_DIS_PNP_VID_SRC=2
# CONFIG_BT_DIS_PNP_VID=0x1915
# CONFIG_BT_DIS_PNP_PID=0xEEEE
# CONFIG_BT_DIS_PNP_VER=0x0100

# CONFIG_DK_LIBRARY=y

CONFIG_SYSTEM_WORKQUEUE_STACK_SIZE=4096

# CONFIG_BT_SETTINGS=y
# CONFIG_FLASH=y
# CONFIG_FLASH_PAGE_LAYOUT=y
# CONFIG_FLASH_MAP=y
# CONFIG_NVS=y
# CONFIG_SETTINGS=y

# CONFIG_DYNAMIC_INTERRUPTS=y
# CONFIG_DYNAMIC_DIRECT_INTERRUPTS=y

# CONFIG_ESB=y
# CONFIG_ESB_DYNAMIC_INTERRUPTS=y
# # CONFIG_ESB_MAX_PAYLOAD_LENGTH=110
# CONFIG_ESB_MAX_PAYLOAD_LENGTH=77
# CONFIG_ESB_TX_FIFO_SIZE=12

# 7.5ms BT connection interval
# CONFIG_BT_PERIPHERAL_PREF_MIN_INT=6
# CONFIG_BT_PERIPHERAL_PREF_MAX_INT=6

#Packet Timer
# CONFIG_NRFX_TIMER3=y

#PDM
CONFIG_AUDIO=y
CONFIG_AUDIO_DMIC=y

# Application Event Manager
CONFIG_APP_EVENT_MANAGER=y

CONFIG_THREAD_NAME=y
# CONFIG_IDLE_STACK_SIZE=1024

CONFIG_NCS_SAMPLES_DEFAULTS=y
CONFIG_MULTIACK_RADIO=y
CONFIG_MULTIACK_CENTRAL=n
CONFIG_MULTIACK_PERIPH=y
CONFIG_MULTIACK_DEBUG_GPIO=y

# CONFIG_NRFX_TIMER0=y
# CONFIG_NRFX_GPPI=y

CONFIG_DK_LIBRARY=y

CONFIG_FPU=y

CONFIG_NRF_GRTC_TIMER=y
```

## boards/nrf54l15dk_nrf54l15_cpuapp.conf
```kconfig
#
# Copyright (c) 2025 Nordic Semiconductor
#
# SPDX-License-Identifier: LicenseRef-Nordic-5-Clause
#
# CONFIG_NRFX_TIMER10=y
# # Enable DPPI driver
# CONFIG_NRFX_DPPI10=y
```

## boards/nrf54l15dk_nrf54l15_cpuapp.overlay
```dts
&pinctrl {
	pdm20_default_alt: pdm20_default_alt {
		group1 {
			psels = <NRF_PSEL(PDM_CLK, 1, 12)>,
				<NRF_PSEL(PDM_DIN, 1, 13)>;
		};
	};
};

dmic_dev: &pdm20 {
	status = "okay";
	pinctrl-0 = <&pdm20_default_alt>;
	pinctrl-names = "default";
	clock-source = "PCLK32M";
};
```

## boards/thingy52_nrf52832.overlay
```dts
// To get started, press Ctrl+Space to bring up the completion menu and view the available nodes.

// You can also use the buttons in the sidebar to perform actions on nodes.
// Actions currently available include:

// * Enabling / disabling the node
// * Adding the bus to a bus
// * Removing the node
// * Connecting ADC channels

// For more help, browse the DeviceTree documentation at https://docs.zephyrproject.org/latest/guides/dts/index.html
// You can also visit the nRF DeviceTree extension documentation at https://nrfconnect.github.io/vscode-nrf-connect/devicetree/nrfdevicetree.html


&pinctrl {
	pdm0_default_alt: pdm0_default_alt {
		group1 {
			psels = <NRF_PSEL(PDM_CLK, 0, 26)>,
				<NRF_PSEL(PDM_DIN, 0, 25)>;
		};
	};
};

dmic_dev: &pdm0 {
	status = "okay";
	pinctrl-0 = <&pdm0_default_alt>;
	pinctrl-names = "default";
	clock-source = "PCLK32M_HFXO";
};
```

## src/main.c
```c
/*
 * Copyright (c) 2019 Nordic Semiconductor ASA
 *
 * SPDX-License-Identifier: LicenseRef-Nordic-5-Clause
 */

/*
MODIFIED SAMPLE TO INCLUDE EXTENSIONS ++
*/

#include <zephyr/kernel.h>
#include <zephyr/drivers/clock_control.h>
#include <zephyr/drivers/clock_control/nrf_clock_control.h>
#include <zephyr/console/console.h>
#include <app_event_manager.h>
#include <string.h>
#include <zephyr/sys/printk.h>
#include <zephyr/types.h>
#include <zephyr/logging/log.h>
#include <zephyr/drivers/gpio.h> 
#include <dk_buttons_and_leds.h>
// #include <esb.h>
// #include "app_bt_hid.h"
// #include "app_timeslot.h"
// #include "app_esb.h"
#include "drv_mic.h"
#include "mic_work_event.h"
#include "sound_service.h"
#include "esb_handler.h"

LOG_MODULE_REGISTER(main, CONFIG_ESB_BT_LOG_LEVEL);


#define FW_VERSION		"1.2.0"

/*
 * Get button configuration from the devicetree sw0 alias. This is mandatory.
 */
#define USER_BUTTON             DK_BTN2_MSK

static volatile bool button_flag = false;


static const struct gpio_dt_spec leds[] = {
	GPIO_DT_SPEC_GET(DT_ALIAS(led0), gpios),
	GPIO_DT_SPEC_GET(DT_ALIAS(led1), gpios),
	GPIO_DT_SPEC_GET(DT_ALIAS(led2), gpios),
	GPIO_DT_SPEC_GET(DT_ALIAS(led3), gpios),
};



static int leds_init(void)
{
	int err;

	if (!device_is_ready(leds[0].port)) {
		LOG_ERR("LEDs port not ready");
		return -ENODEV;
	}


	for (size_t i = 0; i < ARRAY_SIZE(leds); i++) {
		err = gpio_pin_configure_dt(&leds[i], GPIO_OUTPUT);
		if (err) {
			LOG_ERR("Cannot configure LED gpio");
			return err;
		}
		gpio_pin_set(leds[i].port, leds[i].pin, 0);
	}

	return 0;
}


void turn_on_off_led(uint8_t idx, bool onOff)
{
	if(onOff == true)
	{
		gpio_pin_set(leds[idx].port, leds[idx].pin, 1);
	}
	else
	{	
		gpio_pin_set(leds[idx].port, leds[idx].pin, 0);
	}
}

int leds_toggle(uint8_t idx) 
{
	gpio_pin_toggle(leds[idx].port, leds[idx].pin);

	return 0;
}


static void button_changed(uint32_t button_state, uint32_t has_changed)
{

	// printk("Button state: 0x%08x, has changed: 0x%08x", button_state, has_changed);
	if (has_changed & USER_BUTTON) 
	{
		uint32_t user_button_state = button_state & USER_BUTTON;
		if (!user_button_state) 
		{
			button_flag = !button_flag;
	
			if(button_flag)
			{
				struct mic_work_event *mic_event = new_mic_work_event();
				mic_event->type = MIC_STATUS_START;
				APP_EVENT_SUBMIT(mic_event);
				// LOG_INF("Button pressed, micphone start to work!");
			}
			else
			{
				struct mic_work_event *mic_event = new_mic_work_event();
				mic_event->type = MIC_STATUS_STOP;
				APP_EVENT_SUBMIT(mic_event);
				// LOG_INF("Button released, micphone stop to work!");
			}
		}
	}
}

static int init_button(void)
{
	int err;

	err = dk_buttons_init(button_changed);
	if (err) {
		printk("Cannot init buttons (err: %d)\n", err);
	}

	return err;
}


int main(void)
{
	int err;

	err = leds_init();
	if (err) {
		LOG_ERR("LEDs init failed (err %d)", err);
		return err;
	}
	
	err = init_button();
	if (err) {
		LOG_ERR("Cannot init buttons (err: %d)\n", err);
	}

	drv_audio_init();

	err = app_event_manager_init();
	if (err) {
		LOG_ERR("Unable to init Application Event Manager (%d)", err);
		return err;
	}

	inverse_esb_init();

	NRF_POWER->TASKS_CONSTLAT = 1; // Enable constant latency mode, will increase power consumption

	LOG_INF("ESB BLE Multiprotocol Example, version is %s!\r\n",FW_VERSION);
	LOG_INF("Main thread priority is %d!\r\n",k_thread_priority_get(k_current_get()));

	return 0;
}
```

## src/esb_handler.c
```c
#include <zephyr/kernel.h>
#include <zephyr/logging/log.h>

#include "esb_handler.h"


LOG_MODULE_REGISTER(esb_handler, LOG_LEVEL_INF);


#define DEV_NUM			1


/***********inv_esb_variables *********************************************************/
static uint8_t radio_dev_num = DEV_NUM;
static uint8_t radio_group;

#if 0
static uint8_t tx_packet[] = { 0, '1', '2', '3', '4', '5', '6','7', \
				'a', 'b', 'c', 'd', 'e', 'f', 'g','h', \
				'0', '1', '2', '3', '4', '5', '6','7', \
				'a', 'b', 'c', 'd', 'e', 'f', 'g','h', };

#endif

extern int leds_toggle(uint8_t idx);

static void radio_evt_cb(radio_evt_t const * p_event)
{
	static uint32_t timeCount = 0;

	switch(p_event->evt_id) {
	case RADIO_EVENT_PERIPH_POLL_RCV:
		if (p_event->data_len) {
			bool last_send_flag = p_event->data[0];
			if(last_send_flag)
			{
				delete_tx_item_from_queue();
				/** below code just for test */
				// tx_packet[0]++;
				// inv_esb_package_enqueue(tx_packet, sizeof(tx_packet));
			}
		}

		if(0 == (timeCount++ % 100))
			leds_toggle(1);

		break;
	default:
		break;
	}
}




static uint16_t get_periph_dev_num(void)
{
	return (radio_group << 8) + radio_dev_num;
}

int inverse_esb_start(void)
{
	int err;

	err = radio_set_dev_num(get_periph_dev_num());

	if (!err) {
		radio_start_receive();
	} else {
		LOG_ERR("Setting radio failed (err %d)", err);
	}

	// inv_esb_package_enqueue(tx_packet, sizeof(tx_packet));			//for test

	return err;
}



void inverse_esb_init(void)
{
	radio_init_t radio_init;

	radio_init.dev_num				= DEV_NUM;
	radio_init.mode					= PHY_MODE;
	radio_init.event_callback		= radio_evt_cb;

	radio_setup(&radio_init);
}
```

## src/esb_handler.h
```c
#ifndef __ESB_HANDLER_H
#define __ESB_HANDLER_H

#include <zephyr/kernel.h>

// #include "../../lib/adpcm_lib/dvi_adpcm.h"
#include "../../lib/inv_esb_lib/radio.h"
#include "opus.h"
#include "opus_application_config.h"




extern int inverse_esb_start(void);

extern void inverse_esb_init(void);


#endif
```

## src/sound_service.c
```c
#include <zephyr/kernel.h>
#include <zephyr/audio/dmic.h>
#include <zephyr/sys/printk.h>
#include <zephyr/sys/__assert.h>
#include <zephyr/logging/log.h>
#include "sound_service.h"
#include "mic_work_event.h"
#include "esb_handler.h"

LOG_MODULE_REGISTER(sound_service, LOG_LEVEL_INF);

#define SOUND_STACK_SIZE        30720
#define SOUND_PRIORITY          5

/* Milliseconds to wait for a block to be read. */
#define READ_TIMEOUT            1000

/** opus variables and functions */
#define OPUS_ENCODER_SIZE   11924


__ALIGN(4) static uint8_t m_opus_encoder[OPUS_ENCODER_SIZE];
static OpusEncoder * const m_opus_encoder_state = (OpusEncoder *)m_opus_encoder;

static uint8_t m_opus_complexity = CONFIG_OPUS_COMPLEXITY;
static int32_t m_opus_bitrate    = ((CONFIG_OPUS_BITRATE != 0) ? CONFIG_OPUS_BITRATE : OPUS_AUTO);
static bool m_opus_vbr        = ((CONFIG_OPUS_BITRATE == 0) || (CONFIG_OPUS_VBR_ENABLED != 0));
static uint8_t m_opus_channels   = CONFIG_OPUS_CHANNELS;
static uint32_t packID = 0;

static void opus_encoder_configure(void)
{
	printk("opus_encoder_get_size() = %d\n", opus_encoder_get_size(m_opus_channels));
	__ASSERT_NO_MSG(opus_encoder_get_size(m_opus_channels) <= sizeof(m_opus_encoder));
	__ASSERT_NO_MSG(opus_encoder_init(m_opus_encoder_state, CONFIG_AUDIO_SAMPLING_FREQUENCY, m_opus_channels, OPUS_APPLICATION_RESTRICTED_LOWDELAY) == OPUS_OK);

	__ASSERT_NO_MSG(opus_encoder_ctl(m_opus_encoder_state, OPUS_SET_BITRATE(m_opus_bitrate))                      == OPUS_OK);
	__ASSERT_NO_MSG(opus_encoder_ctl(m_opus_encoder_state, OPUS_SET_VBR(m_opus_vbr))                              == OPUS_OK);
	__ASSERT_NO_MSG(opus_encoder_ctl(m_opus_encoder_state, OPUS_SET_VBR_CONSTRAINT((m_opus_bitrate != OPUS_AUTO)))== OPUS_OK);

	__ASSERT_NO_MSG(opus_encoder_ctl(m_opus_encoder_state, OPUS_SET_COMPLEXITY(m_opus_complexity))                == OPUS_OK);

	__ASSERT_NO_MSG(opus_encoder_ctl(m_opus_encoder_state, OPUS_SET_SIGNAL(OPUS_AUTO))                            == OPUS_OK);
	__ASSERT_NO_MSG(opus_encoder_ctl(m_opus_encoder_state, OPUS_SET_LSB_DEPTH(8))                                == OPUS_OK);
	__ASSERT_NO_MSG(opus_encoder_ctl(m_opus_encoder_state, OPUS_SET_DTX(0))                                       == OPUS_OK);
	__ASSERT_NO_MSG(opus_encoder_ctl(m_opus_encoder_state, OPUS_SET_INBAND_FEC(0))                                == OPUS_OK);
	__ASSERT_NO_MSG(opus_encoder_ctl(m_opus_encoder_state, OPUS_SET_PACKET_LOSS_PERC(0))                          == OPUS_OK);
}


static bool radio_is_up;


static void mic_data_handle(void *, void *, void *)
{
    void *buffer;
	uint32_t size;

	opus_encoder_configure();

    LOG_INF("Sound service start, wait for PCM data......");

	/** suspend the thread until we received a start event*/
	k_thread_suspend(k_current_get());

    while(1)
    {
        int frame_size;
		uint8_t frame_buf[CONFIG_AUDIO_FRAME_SIZE_BYTES] = {0};

        size = read_audio_data(&buffer, READ_TIMEOUT);
        if(size == CONFIG_AUDIO_FRAME_SIZE_SAMPLES * BYTES_PER_SAMPLE * CONFIG_OPUS_CHANNELS)
        {	
			frame_size = opus_encode(
									m_opus_encoder_state,
									buffer,
									CONFIG_AUDIO_FRAME_SIZE_SAMPLES,
									frame_buf,
									CONFIG_AUDIO_FRAME_SIZE_BYTES
									);
			if(frame_size != CONFIG_AUDIO_FRAME_SIZE_BYTES)
			{
				LOG_ERR("%d", frame_size);
				return;
			}
				
			// LOG_INF("Packet send[%d-%d], 0x%02x, 0x%02x, 0x%02x, 0x%02x  ", size,frame_size,			
			// 	 frame_buf[0],frame_buf[1], frame_buf[2],frame_buf[3]);		

			inv_esb_package_enqueue(packID, frame_buf, frame_size);
			packID++;
	
            free_audio_memory(buffer);
		}
		else
		{
			LOG_ERR("Read audio data failed, size = %d", size);
			free_audio_memory(buffer);
		}
    }
}



K_THREAD_DEFINE(sound_service, SOUND_STACK_SIZE,
                mic_data_handle, NULL, NULL, NULL,
                K_PRIO_PREEMPT(3), 0, 0);


extern void turn_on_off_led(uint8_t idx, bool onOff);
static bool mic_work_event_handler(const struct app_event_header *aeh)
{
	if (is_mic_work_event(aeh)) 
	{
		struct mic_work_event *event = cast_mic_work_event(aeh);
		if (event->type == MIC_STATUS_START) 
		{
			/** radio work imediately in case of loss audio packet */
			if(!radio_is_up)
			{
				inverse_esb_start();
				radio_is_up = true;
				LOG_INF("Radio start");
			}

            LOG_INF("Micphone start to work!");
			packID = 0;
			drv_mic_start();

			k_thread_resume(sound_service);
			
			turn_on_off_led(0, true);
		}
		else if(event->type == MIC_STATUS_STOP)
		{
            LOG_INF("Micphone stop to work!");
			drv_mic_stop();

			k_thread_suspend(sound_service);

            turn_on_off_led(0, false);
			/** radio work longer to  send the rest audio frame */
			// if(radio_is_up)
			// {
			// 	radio_stop();
			// 	radio_is_up = false;
			// 	LOG_INF("Radio stop");
			// }
		}

		return true;
	}
	else
	{
		return false;
	}
}


APP_EVENT_LISTENER(mic_work, mic_work_event_handler);
APP_EVENT_SUBSCRIBE(mic_work, mic_work_event);
```

## src/sound_service.h
```c
#ifndef __SOUND_SERVICE_H__
#define __SOUND_SERVICE_H__

#include "drv_mic.h"


#endif
```
