## CMakeLists.txt
```
#
# Copyright (c) 2018 Nordic Semiconductor
#
# SPDX-License-Identifier: LicenseRef-Nordic-5-Clause
#
cmake_minimum_required(VERSION 3.20.0)

find_package(Zephyr REQUIRED HINTS $ENV{ZEPHYR_BASE})
project(NONE)

set(OPUS_LIBRARY_ROOT ${CMAKE_CURRENT_LIST_DIR}/lib CACHE PATH "Opus library root directory")
set(ENV{OPUS_LIBRARY_ROOT} $OPUS_LIBRARY_ROOT)

zephyr_link_libraries(-mfloat-abi=hard)
zephyr_link_libraries(-mfpu=fpv4-sp-d16 -ffunction-sections -fdata-sections -fno-strict-aliasing -mthumb -mabi=aapcs)

FILE(GLOB app_sources src/*.c)
# NORDIC SDK APP START
target_sources(app PRIVATE 
    ${app_sources}
    # lib/adpcm_lib/dvi_adpcm.c
    lib/inv_esb_lib/radio.c)
# NORDIC SDK APP END

zephyr_library_include_directories(lib/inv_esb_lib)
# zephyr_library_include_directories(../lib/adpcm_lib)
zephyr_include_directories(lib/opus/opus_include/opus-1.2.1)
zephyr_include_directories(lib/opus/opus_configuration)
target_link_libraries(app PRIVATE ${OPUS_LIBRARY_ROOT}/opus/opus_library/opus_lib.a)
```

## Kconfig
```
#
# Copyright (c) 2020 Nordic Semiconductor
#
# SPDX-License-Identifier: LicenseRef-Nordic-5-Clause
#

source "Kconfig.zephyr"

rsource "lib/inv_esb_lib/Kconfig"

menu "Inverse Enhanced ShockBurst: Receiver"

config ESB_PRX_APP_LOG_LEVEL
	int "Log level for the ESB PRX sample"
	default 4

endmenu
```

## prj.conf
```kconfig
#
# Copyright (c) 2019 Nordic Semiconductor ASA
#
# SPDX-License-Identifier: LicenseRef-Nordic-5-Clause
#
# CONFIG_NCS_SAMPLES_DEFAULTS=y
CONFIG_MAIN_STACK_SIZE=4096
CONFIG_SYSTEM_WORKQUEUE_STACK_SIZE=2048
# CONFIG_ESB=y
# # CONFIG_ESB_MAX_PAYLOAD_LENGTH=110
# CONFIG_ESB_MAX_PAYLOAD_LENGTH=77



#LOG subsystem related configs
CONFIG_LOG=y
CONFIG_LOG_MODE_DEFERRED=y
# CONFIG_USB_DRIVER_LOG_LEVEL_ERR=y
# CONFIG_USB_DEVICE_LOG_LEVEL_ERR=y
# CONFIG_USB_AUDIO_LOG_LEVEL_DBG=y


#net buf options
CONFIG_NET_BUF=y

#USB audio related configs
CONFIG_USB_DEVICE_AUDIO=y
# CONFIG_USB_NRFX_EVT_QUEUE_SIZE=64
CONFIG_USB_NRFX_WORK_QUEUE_STACK_SIZE=2048
# CONFIG_USB_MCUX_THREAD_STACK_SIZE=2048
# CONFIG_USB_DC_NUMAKER_MSG_HANDLER_THREAD_STACK_SIZE=2048
CONFIG_RING_BUFFER=y
CONFIG_USB_DEVICE_STACK=y
CONFIG_USB_DEVICE_PRODUCT="Smart Remote dongle"


# Image manager
CONFIG_STDOUT_CONSOLE=y
CONFIG_FLASH=y
CONFIG_MPU_ALLOW_FLASH_WRITE=y
CONFIG_SOC_FLASH_NRF_EMULATE_ONE_BYTE_WRITE_ACCESS=y
CONFIG_FCB=y
CONFIG_FLASH_MAP=y
CONFIG_SETTINGS=y
CONFIG_SETTINGS_FCB=y


CONFIG_NCS_SAMPLES_DEFAULTS=y

## inverse esb config
CONFIG_MULTIACK_RADIO=y
CONFIG_MULTIACK_CENTRAL=y
CONFIG_MULTIACK_PERIPH=n
CONFIG_MULTIACK_DEBUG_GPIO=y

CONFIG_NRFX_TIMER0=y
CONFIG_NRFX_GPPI=y

CONFIG_FPU=y

CONFIG_PCM_MIX=y
```

## boards/nrf54l15dk_nrf54l15_cpuapp.conf
```kconfig
#
# Copyright (c) 2025 Nordic Semiconductor
#
# SPDX-License-Identifier: LicenseRef-Nordic-5-Clause
#

# Enable DPPI driver
CONFIG_NRFX_DPPI10=y

CONFIG_PM_PARTITION_SIZE_SETTINGS_STORAGE=0x100000
```

## src/main.c
```c
/*
 * Copyright (c) 2018 Nordic Semiconductor ASA
 *
 * SPDX-License-Identifier: LicenseRef-Nordic-5-Clause
 */
#include <zephyr/device.h>
#include <zephyr/devicetree.h>
#include <zephyr/drivers/clock_control.h>
#include <zephyr/drivers/clock_control/nrf_clock_control.h>
#include <zephyr/drivers/gpio.h>
#include <zephyr/irq.h>
#include <zephyr/logging/log.h>
#include <nrf.h>
// #include <esb.h>
#include <zephyr/kernel.h>
#include <zephyr/types.h>
#include "esb_handle.h"
// #include "dvi_adpcm.h"
#include "audio_handle.h"



LOG_MODULE_REGISTER(smart_dongle, CONFIG_ESB_PRX_APP_LOG_LEVEL);

#define FW_VERSION				"1.2.0"


static const struct gpio_dt_spec leds[] = {
	GPIO_DT_SPEC_GET(DT_ALIAS(led0), gpios),
	GPIO_DT_SPEC_GET(DT_ALIAS(led1), gpios),
	GPIO_DT_SPEC_GET(DT_ALIAS(led2), gpios),
	GPIO_DT_SPEC_GET(DT_ALIAS(led3), gpios),
};



static int leds_init(void)
{
	if (!device_is_ready(leds[0].port)) {
		LOG_ERR("LEDs port not ready");
		return -ENODEV;
	}

	for (size_t i = 0; i < ARRAY_SIZE(leds); i++) {
		int err = gpio_pin_configure_dt(&leds[i], GPIO_OUTPUT);

		if (err) {
			LOG_ERR("Unable to configure LED%u, err %d.", i, err);
			return err;
		}

		gpio_pin_set(leds[0].port, leds[i].pin, 0);
	}

	return 0;
}



int leds_toggle(uint8_t idx) 
{
	// for (size_t i = 0; i < ARRAY_SIZE(leds); i++) 
	{
		gpio_pin_toggle(leds[0].port, leds[idx].pin);
	}

	return 0;
}

int led_on_off(uint8_t idx, bool on)
{
	if (idx >= ARRAY_SIZE(leds)) {
		LOG_ERR("Invalid LED index %u", idx);
		return -EINVAL;
	}

	int err = gpio_pin_set(leds[0].port, leds[idx].pin, on ? 1 : 0);
	if (err) {
		LOG_ERR("Failed to set LED%u state, err %d", idx, err);
		return err;
	}

	return 0;
}


int clocks_start(void)
{
	int err;
	int res;
	struct onoff_manager *clk_mgr;
	struct onoff_client clk_cli;

	clk_mgr = z_nrf_clock_control_get_onoff(CLOCK_CONTROL_NRF_SUBSYS_HF);
	if (!clk_mgr) {
		LOG_ERR("Unable to get the Clock manager");
		return -ENXIO;
	}

	sys_notify_init_spinwait(&clk_cli.notify);

	err = onoff_request(clk_mgr, &clk_cli);
	if (err < 0) {
		LOG_ERR("Clock request failed: %d", err);
		return err;
	}

	do {
		err = sys_notify_fetch_result(&clk_cli.notify, &res);
		if (!err && res) {
			LOG_ERR("Clock could not be started: %d", res);
			return res;
		}
	} while (err);

	// LOG_DBG("HF clock started, fw_version is %s", FW_VERSION);
	return 0;
}




int main(void)
{
	int err;

	// err = clocks_start();
	// if (err) {
	// 	return err;
	// }

	err = leds_init();
	if (err) {
		return err;
	}

	inverse_esb_init();

	radio_start_poll();

	LOG_DBG("Inverse esb dongle demo, fw_version is %s", FW_VERSION);

	/* return to idle thread */
	return 0;
}
```

## src/audio_handle.c
```c
#include <zephyr/kernel.h>
#include <zephyr/logging/log.h>
#include <zephyr/net_buf.h>
#include <zephyr/usb/usb_device.h>
#include <zephyr/usb/class/usb_audio.h>
#include <pcm_mix.h>

#include "audio_handle.h"
#include "esb_handle.h"


LOG_MODULE_DECLARE(smart_dongle, CONFIG_ESB_PRX_APP_LOG_LEVEL);


#define AUDIO_HANDLE_STACK_SIZE        	30720
#define AUDIO_HANDLE_PRIORITY          	3

#define OPUS_DECODER_SIZE   			17944


NET_BUF_POOL_FIXED_DEFINE(pool_out, CONFIG_FIFO_FRAME_SPLIT_NUM, USB_FRAME_SIZE_STEREO, 8, net_buf_destroy);

K_MSGQ_DEFINE(esb_queue1, PCM_BLOCK_SIZE, PCM_BLOCK_COUNT, 4);
K_MSGQ_DEFINE(esb_queue2, PCM_BLOCK_SIZE, PCM_BLOCK_COUNT, 4);

static const struct device *const mic_dev = DEVICE_DT_GET_ONE(usb_audio_mic);

/******************************** opus decoder variables ******************************************/
static uint8_t m_opus_channels   = CONFIG_OPUS_CHANNELS;
__ALIGN(4) static uint8_t m_opus_decoder[OPUS_DECODER_SIZE];
static OpusDecoder * const m_opus_decoder_state = (OpusDecoder *)m_opus_decoder;

/** this pointer variable used for transport the message queue to USB audio thread.*/
// void *block_ptr = NULL;

extern struct k_msgq m_msgq_rx_payloads;

extern int leds_toggle(uint8_t idx);



static void handle_audio_data(const struct device *dev)
{
	// LOG_INF("data were requested from the device and may be send to the Host!");
	static uint32_t timeCount = 0;

    int ret = 0;
	volatile bool channel1_flag = false;
	volatile bool channel2_flag = false;
	// int16_t frame_buffer1[FRAME_SIZE] = {0};
	// int16_t frame_buffer2[FRAME_SIZE] = {0};
    size_t data_out_size = 0;
     
    struct net_buf *buf_out;

	buf_out = net_buf_alloc(&pool_out, K_NO_WAIT);
	if (!buf_out) 
	{
		LOG_ERR("Failed to allocate data buffer");
		// return;
	}

    if(k_msgq_get(&esb_queue1, (int16_t*)buf_out->data, K_NO_WAIT) == 0)
    {
        channel1_flag = true;
    }
	else if(k_msgq_get(&esb_queue2, (int16_t*)buf_out->data, K_NO_WAIT) == 0)
    {
        channel2_flag = true;
    }
   
	if(!channel1_flag && !channel2_flag)
	{
		LOG_ERR("Both audio buffers are NULL");
		// net_buf_unref(buf_out);
		// return;
		memset(buf_out->data, 0, buf_out->size);
	}

	data_out_size =  buf_out->size;
	// LOG_INF("USB audio TX data size: %d", data_out_size);
#if 1
	 /** USB audio driver handle the pcm stream*/
	if (data_out_size == usb_audio_get_in_frame_size(dev)) 
	{
		ret = usb_audio_send(dev, buf_out, data_out_size);
		if (ret) {
			LOG_WRN("USB TX failed, ret: %d", ret);
			net_buf_unref(buf_out);
		}
		else
		{	
			if(0 == (timeCount++ % 50))
				leds_toggle(2);
			// LOG_INF("usb audio send %d bytes succeed!\t", data_out_size);
		}
	} 
    else 
#endif
    {
		// LOG_WRN("Wrong size write: %d", data_out_size);
		net_buf_unref(buf_out);
	}
}


static void feature_update(const struct device *dev,
			   const struct usb_audio_fu_evt *evt)
{
	LOG_DBG("Control selector %d for channel %d updated",
		evt->cs, evt->channel);
	switch (evt->cs) {
	case USB_AUDIO_FU_MUTE_CONTROL:
	default:
		break;
	}
}


static const struct usb_audio_ops mic_ops = {
	.data_request_cb = handle_audio_data,
	.feature_update_cb = feature_update,
};


/*********************************opus decoder*********************************************/

static void opus_decoder_configure(void)
{
        printk("opus_decoder_get_size() = %d\n", opus_decoder_get_size(m_opus_channels));        
        __ASSERT_NO_MSG(opus_decoder_get_size(m_opus_channels) <= sizeof(m_opus_decoder));
        __ASSERT_NO_MSG(opus_decoder_init(m_opus_decoder_state, CONFIG_AUDIO_SAMPLING_FREQUENCY, m_opus_channels) == OPUS_OK);
}



void esb_buffer_handle(void)
{
    int err = 0;
    struct inv_esb_payload rx_payload;
	int16_t block_ptr[PCM_FRAME_BYTES];
	// 1ms buffer
    // int16_t slice_buf[FRAME_SIZE];

	if(k_msgq_get(&m_msgq_rx_payloads, &rx_payload, K_FOREVER) == 0)
    {
		uint16_t pcm_index = 0;
		int frame_size = 0;
		uint8_t devID = rx_payload.dev_id;
		uint32_t packet_id = rx_payload.data[0] | (rx_payload.data[1] << 8) | (rx_payload.data[2] << 16) | (rx_payload.data[3] << 24);

        // LOG_INF("Packet received[%d] from %d, 0x%02x, 0x%02x, 0x%02x, 0x%02x  ", rx_payload.length,			
		// 		devID, rx_payload.data[0],rx_payload.data[1], rx_payload.data[2],rx_payload.data[3]);

		frame_size = opus_decode(m_opus_decoder_state, 
								&rx_payload.data[4], 
								CONFIG_AUDIO_FRAME_SIZE_BYTES, 
								block_ptr, 
								CONFIG_AUDIO_FRAME_SIZE_SAMPLES, 0);

		// LOG_INF("%d--%d", packet_id, frame_size);
		if(frame_size != CONFIG_AUDIO_FRAME_SIZE_SAMPLES)	
		{															
			// LOG_INF("%d--%d: 0x%02x, 0x%02x, 0x%02x, 0x%02x", rx_payload.length, frame_size, rx_payload.data[0],rx_payload.data[1],
			// 		rx_payload.data[MAX_PAYLOAD_SIZE-2],rx_payload.data[MAX_PAYLOAD_SIZE-1]);
			return;
		}
	#if 1
		/** send the PCM data to USB audio driver*/
		if(devID == 1)
		{
			while(pcm_index + FRAME_SIZE <= frame_size * 2) // 2 channels
			{
				err = k_msgq_put(&esb_queue1, &block_ptr[pcm_index], K_NO_WAIT);
				if(!err)
				{
					pcm_index += FRAME_SIZE;
				}
				else
				{
					LOG_ERR("1[%d] Message sent error: %d", pcm_index, err);
					break;
				}
			}
			// LOG_INF("esb_queue1: %d", pcm_index);
		}
		else if(devID == 2)
		{	
			while(pcm_index + FRAME_SIZE <= frame_size * 2) // 2 channels
			{
				err = k_msgq_put(&esb_queue2, &block_ptr[pcm_index], K_NO_WAIT);			
				if(!err)
				{
					pcm_index += FRAME_SIZE;
				}
				else
				{
					LOG_ERR("2[%d] Message sent error: %d", pcm_index, err);
					break;
				}
			}
			// LOG_INF("esb_queue2: %d", pcm_index);
		}
		else
		{
			err = -EINVAL;
		}
	#endif
    } 
    else 
    {
        LOG_ERR("Error while reading esb rx packet");
    }
}

static void esb_audio_data_handle(void *, void *, void *)
{
	int ret;
	// soc_flash_init();

	if (!device_is_ready(mic_dev)) {
		LOG_ERR("Device USB Microphone is not ready");
		return;
	}
	LOG_INF("Found USB Microphone Device");

	usb_audio_register(mic_dev, &mic_ops);

	ret = usb_enable(NULL);
	if (ret != 0) {
		LOG_ERR("Failed to enable USB");
		return;
	}

	opus_decoder_configure();

	LOG_INF("USB enabled");
	LOG_INF("mic_frame_size = %d\t ", usb_audio_get_in_frame_size(mic_dev));

    while(1)
    {
		esb_buffer_handle();
    }
}


K_THREAD_DEFINE(esb_audio_service, AUDIO_HANDLE_STACK_SIZE,
                esb_audio_data_handle, NULL, NULL, NULL,
                K_PRIO_PREEMPT(AUDIO_HANDLE_PRIORITY), 0, 0);
```

## src/audio_handle.h
```c
#ifndef __USB_AUDIO_APP_H__
#define __USB_AUDIO_APP_H__

#include <stdint.h>


#define MAX_SAMPLE_RATE             16000
#define SAMPLE_BIT_WIDTH            16
#define BYTES_PER_SAMPLE            sizeof(int16_t)

// #define CONFIG_AUDIO_SAMPLE_RATE_HZ         16000
// #define CONFIG_AUDIO_BIT_DEPTH_OCTETS       2

#define USB_FRAME_SIZE_STEREO               (((MAX_SAMPLE_RATE * BYTES_PER_SAMPLE) / 1000) *2)

#define CONFIG_FIFO_FRAME_SPLIT_NUM         100




/* Size of a block for 1 ms of audio data. */
#define BLOCK_SIZE(_sample_rate, _number_of_ms) \
	(BYTES_PER_SAMPLE * (_sample_rate / 1000) * _number_of_ms)


#define PCM_BLOCK_SIZE				BLOCK_SIZE(MAX_SAMPLE_RATE, 1) 			// 1 ms
#define FRAME_SIZE                  (MAX_SAMPLE_RATE / 1000)

#define ESB_BLOCK_COUNT             10
#define PCM_BLOCK_COUNT             100



#endif
```

## src/esb_handle.c
```c
#include <zephyr/kernel.h>
#include <zephyr/logging/log.h>
// #include <esb.h>
// #include "dvi_adpcm.h"
#include "esb_handle.h"


LOG_MODULE_DECLARE(smart_dongle, CONFIG_ESB_PRX_APP_LOG_LEVEL);


#define DEV_NUM					0xFFFF //0xFFFF being central


/*************inverse esb variables ******************************************************/

static bool new_pkt_received;


/*****************************************************************************************/ 
K_MSGQ_DEFINE(m_msgq_rx_payloads, sizeof(struct inv_esb_payload), 60, 4);

extern int leds_toggle(uint8_t idx);


static int received_esb_package_enqueue(uint8_t devID, const uint8_t *buf, uint32_t length)
{
	int ret = 0;
	static struct inv_esb_payload rx_payload;

	if (length > MAX_PAYLOAD_SIZE) {
		LOG_ERR("Payload length %d exceeds maximum %d", length, MAX_PAYLOAD_SIZE);
		return -EMSGSIZE;
	}

	rx_payload.dev_id = devID;
	memcpy(rx_payload.data, buf, length);
	rx_payload.length = length;
	ret = k_msgq_put(&m_msgq_rx_payloads, &rx_payload, K_NO_WAIT);
	if (ret)  {
		// LOG_INF("Audio message queue is full");
		return -ENOMEM;
	}
	return ret;
}



static void radio_evt_cb(radio_evt_t const * p_event)
{
	static uint32_t timeCount1 = 0;
	static uint32_t timeCount2 = 0;

	switch(p_event->evt_id) {
	case RADIO_EVENT_CENTRAL_DATA_RCV:
		if (p_event->data_len) {
			// Toggle one of the LEDs.
			if (p_event->periph_num == 1) {
				if(0 == (timeCount1++ % 50))
					leds_toggle(0);
			} else if (p_event->periph_num == 2) {
				if(0 == (timeCount2++ % 50))
					leds_toggle(1);
			} 
			// LOG_INF("Rec %d from %d: %d", p_event->data_len, p_event->periph_num, p_event->data[0]);

			/** enqueue compressed audio data to message queue */
			received_esb_package_enqueue(p_event->periph_num, (const uint8_t *)p_event->data, p_event->data_len);
		}
		new_pkt_received = true;
		break;
	case RADIO_EVENT_CENTRAL_POLL_END:
		if (new_pkt_received) {
			new_pkt_received = false;

			increase_poll_index();
		}
		break;
	default:
		break;
	}
}


void inverse_esb_init(void)
{
	radio_init_t radio_init;

	radio_init.dev_num			= DEV_NUM;
	radio_init.mode				= PHY_MODE;
	radio_init.event_callback	= radio_evt_cb;

	radio_setup(&radio_init);
}
```

## src/esb_handle.h
```c
#ifndef __ESB_HANDLE_H__
#define __ESB_HANDLE_H__

#include <stdint.h>

#include "../lib/inv_esb_lib/radio.h"
#include "../lib/inv_esb_lib/radio_config_5ms.h"
#include "opus.h"
#include "opus_application_config.h"



void inverse_esb_init(void);





#endif
```
